#include <stdio.h>
#include <stdlib.h>
#include <string.h>
#include <unity.h>

// Boots the real Gorf ROM on the host through the machine class: line and
// lightpen IRQs, funcgen/pattern board, votrax request polling. Gorf
// speaks only after a coin (MAME: attract writes STOP phones only, first
// phone 17 frames after the coin), so the test inserts one. Renders one
// frame to $TMPDIR/gorf_frame.ppm for a look by eye. The ROM headers are
// generated by romconv (./convert.sh gorf) and not in the repo: without
// them the test is skipped. Arduino.h / FastLED.h / esp_attr.h in this
// directory are host stubs.
#if __has_include("../../src/machines/gorf/gorf_rom.h")
#define HAVE_ROM 1
#include "../../src/emulation/lzma/LzmaDec.c"
#include "../../src/emulation/arena.cpp"
#include "../../src/cpus/z80/Z80.c"
#define GORF_Z80_TABLES_INCLUDED
#include "../../src/emulation/astrocade_sound.cpp"
#include "../../src/emulation/votrax.cpp"
#include "../../src/machines/gorf/gorf.cpp"
#endif

void setUp(void) {}
void tearDown(void) {}

#ifdef HAVE_ROM
static unsigned int keys;
unsigned int Input::buttons_get(void) { return keys; }
bool Input::demoSoundsOff(void) { return false; }

static gorf *machine;
static uint32_t frame;
static uint32_t stopWrites, phoneWrites, firstPhoneFrame;

static const uint8_t PORT_VOTRAX = 0x17, PHONE_STOP = 0x3f, PHONE_MASK = 0x3f;

extern "C" {
unsigned char OpZ80_INL(unsigned short a) { return machine->opZ80(a); }
unsigned char OpPrefixZ80_INL(unsigned short a) { return machine->opPrefixZ80(a); }
unsigned char RdZ80(unsigned short a) { return machine->rdZ80(a); }
void WrZ80(unsigned short a, unsigned char v) { machine->wrZ80(a, v); }
unsigned char InZ80(unsigned short p) {
  // votrax bytes are written by reading port 0x17 (high byte = data)
  if ((p & 0xff) == PORT_VOTRAX) {
    if (((p >> 8) & PHONE_MASK) == PHONE_STOP) {
      stopWrites++;
    } else {
      if (!phoneWrites) {
        firstPhoneFrame = frame;
      }
      phoneWrites++;
    }
  }
  return machine->inZ80(p);
}
void OutZ80(unsigned short p, unsigned char v) { machine->outZ80(p, v); }
void PatchZ80(Z80 *) {}
word LoopZ80(Z80 *) { return INT_NONE; }
}
void Reset6502(M6502 *) {} // machineBase::reset(), no 6502 here

static Input input;
static unsigned short frame_buffer[240 * 8];
static sprite_S sprites[128];
static unsigned char memory[RAMSIZE];

static const uint32_t ATTRACT_FRAMES = 600;
static const uint32_t COIN_FRAME = 600, START_FRAME = 700, PRESS_FRAMES = 6;
static const uint32_t SPEECH_FRAMES = 900;
static const uint32_t RENDER_FRAME = 1500;
static const int AUDIO_CHUNKS = 6;  // Audio::transmit() per screen

static void boot(void) {
  static bool booted = false;
  if (booted) {
    return;
  }
  booted = true;
  Arena::init();
  machine = new gorf();
  machine->init(&input, frame_buffer, sprites, memory);
  machine->reset();
  machine->start();
  machine->start();
}

// one 60 Hz frame as main.cpp drives it; returns the audio peak
static int32_t runFrame(void) {
  keys = 0;
  if (frame >= COIN_FRAME && frame < COIN_FRAME + PRESS_FRAMES) {
    keys = BUTTON_COIN;
  }
  if (frame >= START_FRAME && frame < START_FRAME + PRESS_FRAMES) {
    keys = BUTTON_START;
  }
  machine->run_frame();
  frame++;

  int32_t peak = 0;
  for (int c = 0; c < AUDIO_CHUNKS; c++) {
    int16_t out[64];
    machine->renderAudio(out, 64);
    for (int i = 0; i < 64; i++) {
      const int32_t a = out[i] < 0 ? -out[i] : out[i];
      peak = a > peak ? a : peak;
    }
  }
  return peak;
}

// attract polls the votrax (STOP phones) and draws: line/lightpen IRQs,
// funcgen and request handling get the game running
static void test_attract_runs(void) {
  boot();
  while (frame < ATTRACT_FRAMES) {
    runFrame();
  }
  printf("attract: %u STOP writes, game_started %d\n", stopWrites, machine->game_started);
  TEST_ASSERT_GREATER_THAN_UINT32(0, stopWrites);
  TEST_ASSERT_TRUE(machine->game_started);

  uint32_t lit = 0;
  for (uint32_t a = 0x4000; a < 0x8000; a++) {
    lit += machine->rdZ80(a) != 0;
  }
  printf("non-zero VRAM bytes %u\n", lit);
  TEST_ASSERT_GREATER_THAN_UINT32(0, lit);
}

// coin: the game speaks; phones only follow when the request line rises
static void test_coin_speaks(void) {
  boot();
  int32_t peak = 0;
  while (frame < SPEECH_FRAMES) {
    const int32_t p = runFrame();
    peak = p > peak ? p : peak;
  }
  printf("speech: %u phones, first at frame %u, audio peak %d\n", phoneWrites, firstPhoneFrame,
         peak);
  TEST_ASSERT_GREATER_THAN_UINT32(20, phoneWrites);
  TEST_ASSERT_GREATER_THAN_INT32(0, peak);
  TEST_ASSERT_LESS_OR_EQUAL_INT32(AUDIO_MAX, peak);
}

// RGB565, bytes swapped for SPI -> 8 bit RGB
static void putPixel(FILE *f, uint16_t v) {
  v = (uint16_t)((v << 8) | (v >> 8));
  const uint8_t rgb[3] = {(uint8_t)((v >> 8) & 0xf8), (uint8_t)((v >> 3) & 0xfc),
                          (uint8_t)((v << 3) & 0xf8)};
  fwrite(rgb, 1, 3, f);
}

// one frame through prepare_frame/render_row into a PPM
static void test_render_frame(void) {
  boot();
  while (frame < RENDER_FRAME) {
    runFrame();
  }
  machine->prepare_frame();

  const char *dir = getenv("TMPDIR");
  char path[512];
  snprintf(path, sizeof(path), "%s/gorf_frame.ppm", dir ? dir : "/tmp");
  FILE *f = fopen(path, "wb");
  TEST_ASSERT_NOT_NULL(f);
  fprintf(f, "P6\n240 288\n255\n");

  uint32_t lit = 0;
  for (int row = 0; row < 36; row++) {
    memset(frame_buffer, 0, sizeof(frame_buffer));
    machine->render_row(row);
    for (int i = 0; i < 240 * 8; i++) {
      putPixel(f, frame_buffer[i]);
      lit += frame_buffer[i] != 0;
    }
  }
  fclose(f);
  printf("frame %u written to %s, %u non-black px\n", frame, path, lit);
  TEST_ASSERT_GREATER_THAN_UINT32(0, lit);
}
#endif

int main(int argc, char **argv) {
  UNITY_BEGIN();
#ifdef HAVE_ROM
  RUN_TEST(test_attract_runs);
  RUN_TEST(test_coin_speaks);
  RUN_TEST(test_render_frame);
#endif
  return UNITY_END();
}
