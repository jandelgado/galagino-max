#include <string.h>
#include <unity.h>

// Boots the real Space Duel ROM on the host and plays coin + START, to
// pin what the game needs from the controls (spacduel_inputs.h). The ROM
// headers are generated by romconv (./convert.sh spacduel) and not in
// the repo: without them the test is skipped.
#if __has_include("../../src/machines/spacduel/spacduel_rom.h")
#define HAVE_ROM 1
#include "../../src/emulation/lzma/LzmaDec.c"
#include "../../src/emulation/arena.cpp"
#include "../../src/emulation/asset.h"
#include "../../src/machines/spacduel/spacduel_rom.h"
#include "../../src/machines/spacduel/spacduel_vrom.h"
#endif
#include "../../src/cpus/m6502/m6502.c"

// input.h needs Arduino.h; same values as there
#define BUTTON_LEFT 0x01
#define BUTTON_RIGHT 0x02
#define BUTTON_UP 0x04
#define BUTTON_DOWN 0x08
#define BUTTON_FIRE 0x10
#define BUTTON_START 0x20
#define BUTTON_A 0x100
#define BUTTON_B 0x200
#include "../../src/machines/spacduel/spacduel_inputs.h"

void setUp(void) {}
void tearDown(void) {}

#ifdef HAVE_ROM
static const uint32_t CYCLES_PER_FRAME = 25200, CYCLES_PER_IRQ = 6144;
static const uint16_t RAM_SELECT = 0x03ee; // spacduel.cpp
static const uint16_t RAM_GAME = 0x03f4; // game type, 1 or 3 with DSW2 "1 player game only"

enum Mapping : uint8_t { START_ONLY, START_SELECTS };

struct Board {
  uint8_t ram[0x400], vram[0x800];
  const uint8_t *rom, *vrom;
  uint32_t cycles;
  bool coin;
  unsigned int keys;
  Mapping mapping;
};

static uint8_t rd(m6502_t *cpu, uint16_t a) {
  Board *b = (Board *)cpu->user;
  if (a >= 0x9000) {
    return b->rom[0x4000 + (a & 0x0fff)];
  }
  if (a >= 0x4000) {
    return b->rom[a - 0x4000];
  }
  if (a < 0x400) {
    return b->ram[a];
  }
  if (a >= 0x2000 && a < 0x2800) {
    return b->vram[a - 0x2000];
  }
  if (a >= 0x2800) {
    return b->vrom[a - 0x2800];
  }
  if ((a & 0xfff8) == 0x0900) {
    const SdSelect s = (b->mapping == START_SELECTS && (b->ram[RAM_SELECT] & 0x80)) ? SD_SELECT_PENDING : SD_SELECTED;
    return spacduel_in1(a & 7, b->keys, s);
  }
  if ((a & 0xf80f) == 0x1008) { // POKEY ALLPOT
    return (a & 0x0400) ? SPACDUEL_DSW1 : SPACDUEL_DSW0;
  }
  if (a == 0x0800) { // coin 1 active low, AVG done, 3 kHz clock
    return (b->coin ? 0x7d : 0x7f) | ((b->cycles & 0x100) ? 0x80 : 0);
  }
  if (a == 0x0a00) {
    return 0xff; // erased EAROM
  }
  return 0;
}

static void wr(m6502_t *cpu, uint16_t a, uint8_t v) {
  Board *b = (Board *)cpu->user;
  if (a < 0x400) {
    b->ram[a] = v;
  } else if (a >= 0x2000 && a < 0x2800) {
    b->vram[a - 0x2000] = v;
  } else if (a == 0x0e00) {
    cpu->irq = 0;
  }
}

static Board board;
static m6502_t cpu;
static uint32_t next_irq;

static void boot(Mapping mapping) {
  static bool arena = false;
  if (!arena) {
    Arena::init();
    arena = true;
  }
  static Asset<unsigned char, COMPRESSED> rom(spacduel_rom_blob), vrom(spacduel_vrom_blob);
  memset(&board, 0, sizeof(board));
  board.rom = rom.data();
  board.vrom = vrom.data();
  board.mapping = mapping;
  memset(&cpu, 0, sizeof(cpu));
  cpu.read = rd;
  cpu.write = wr;
  cpu.user = &board;
  m6502_reset(&cpu);
  next_irq = CYCLES_PER_IRQ;
}

static void frames(uint32_t n) {
  const uint32_t end = board.cycles + n * CYCLES_PER_FRAME;
  while ((int32_t)(board.cycles - end) < 0) {
    if ((int32_t)(board.cycles - next_irq) >= 0) {
      cpu.irq = 1;
      next_irq += CYCLES_PER_IRQ;
    }
    board.cycles += m6502_step(&cpu);
  }
}

static void press(unsigned int keys, uint32_t n) {
  board.keys = keys;
  frames(n);
  board.keys = 0;
  frames(30);
}

// galagino's virtual coin: coin 100 ms, 500 ms pause, START held 100 ms+
static void coin_and_start(void) {
  board.coin = true;
  frames(6);
  board.coin = false;
  frames(30);
  press(BUTTON_START, 10);
  frames(30);
}
#endif

// after power up the game ignores START until Select was pressed once
static void test_start_only_is_ignored(void) {
#ifdef HAVE_ROM
  boot(START_ONLY);
  frames(600);
  TEST_ASSERT_EQUAL_HEX8(0x80, board.ram[RAM_SELECT]);
  coin_and_start();
  TEST_ASSERT_EQUAL_HEX8(0x80, board.ram[RAM_SELECT]);
#else
  TEST_IGNORE_MESSAGE("spacduel ROM headers missing, run romconv");
#endif
}

// START presses Select while pending: one press starts a game
static void test_start_starts_game(void) {
#ifdef HAVE_ROM
  boot(START_SELECTS);
  frames(600);
  coin_and_start();
  TEST_ASSERT_EQUAL_HEX8(0x00, board.ram[RAM_SELECT]);
#else
  TEST_IGNORE_MESSAGE("spacduel ROM headers missing, run romconv");
#endif
}

// first stick press on the select screen highlights the first game, the
// second moves to the second game, START starts it
static void test_down_selects_second_game(void) {
#ifdef HAVE_ROM
  boot(START_SELECTS);
  frames(600);
  board.coin = true;
  frames(6);
  board.coin = false;
  frames(30);
  press(BUTTON_DOWN, 5);
  press(BUTTON_DOWN, 5);
  press(BUTTON_START, 10);
  TEST_ASSERT_EQUAL_HEX8(0x00, board.ram[RAM_SELECT]);
  TEST_ASSERT_EQUAL_HEX8(3, board.ram[RAM_GAME]);
#else
  TEST_IGNORE_MESSAGE("spacduel ROM headers missing, run romconv");
#endif
}

int main(int, char **) {
  UNITY_BEGIN();
  RUN_TEST(test_start_only_is_ignored);
  RUN_TEST(test_start_starts_game);
  RUN_TEST(test_down_selects_second_game);
  return UNITY_END();
}
