#include <stdio.h>
#include <string.h>
#include <unity.h>
#include <initializer_list>

// Boots the real 1943b ROMs on the host through the machine class: main
// and sound Z80, memory map, sound latch, YM2203 FM. The ROM headers are
// generated by romconv (./convert.sh 1943) and not in the repo: without
// them the tests are skipped. Arduino.h / FastLED.h / esp_attr.h in this
// directory are host stubs.
#if __has_include("../../src/machines/1943/1943_rom.h")
#define HAVE_ROM 1
#define ENABLE_1943
#include "../../src/emulation/lzma/LzmaDec.c"
#include "../../src/emulation/arena.cpp"
#include "../../src/cpus/z80/Z80.c"
#include "../../src/emulation/ym2203fm.cpp"
#include "../../src/emulation/ay8910.cpp"
#include "../../src/emulation/ym2203.cpp"
#define private public
#define protected public
#include "../../src/machines/1943/1943.cpp"
#undef private
#undef protected
#endif

void setUp(void) {}
void tearDown(void) {}

#ifdef HAVE_ROM
static unsigned int keys;
unsigned int Input::buttons_get(void) { return keys; }

static _1943 *machine;

extern "C" {
unsigned char OpZ80_INL(unsigned short a) { return machine->opZ80(a); }
unsigned char OpPrefixZ80_INL(unsigned short a) { return machine->opPrefixZ80(a); }
unsigned char RdZ80(unsigned short a) { return machine->rdZ80(a); }
void WrZ80(unsigned short a, unsigned char v) { machine->wrZ80(a, v); }
unsigned char InZ80(unsigned short p) { return machine->inZ80(p); }
void OutZ80(unsigned short p, unsigned char v) { machine->outZ80(p, v); }
void PatchZ80(Z80 *) {}
word LoopZ80(Z80 *) { return INT_NONE; }
}

static Input input;
static unsigned short frame_buffer[224 * 8];
static sprite_S sprites[128];
static unsigned char memory[RAMSIZE];
static uint32_t frame;

static const uint32_t COIN_FRAME = 600;
static const uint32_t START_FRAME = 660;
static const uint32_t PRESS_FRAMES = 5;
static const int AUDIO_CHUNKS = 6; // Audio::transmit() per screen

static void boot(void) {
  static bool booted = false;
  if (booted) {
    return;
  }
  booted = true;
  Arena::init();
  Arena::reserve(&_1943_arena_plan);
  machine = new _1943();
  machine->init(&input, frame_buffer, sprites, memory);
  machine->reset();
  machine->start();
  machine->start();
}

// one 60 Hz frame as main.cpp drives it: emulation, then the audio core
// drains the FM queue 6 x 64 samples; returns the FM peak of the frame
static int32_t runFrame(void) {
  keys = 0;
  if (frame >= COIN_FRAME && frame < COIN_FRAME + PRESS_FRAMES) {
    keys = BUTTON_COIN;
  }
  if (frame >= START_FRAME && frame < START_FRAME + PRESS_FRAMES) {
    keys = BUTTON_START;
  }
  machine->run_frame();
  frame++;

  int32_t peak = 0;
  for (int c = 0; c < AUDIO_CHUNKS; c++) {
    int16_t out[64];
    machine->renderFm(out, 64);
    for (int i = 0; i < 64; i++) {
      const int32_t a = out[i] < 0 ? -out[i] : out[i];
      peak = a > peak ? a : peak;
    }
  }
  return peak;
}

// the game sends its first sound command during boot
static void test_boot_starts_game(void) {
  boot();
  while (frame < 300 && !machine->game_started) {
    runFrame();
  }
  TEST_ASSERT_TRUE(machine->game_started);
}

// attract mode plays no FM (MAME probe); coin + start brings the music
static void test_fm_music_after_coin(void) {
  boot();
  int32_t attract = 0;
  while (frame < COIN_FRAME) {
    const int32_t p = runFrame();
    attract = p > attract ? p : attract;
  }
  TEST_ASSERT_EQUAL_INT32(0, attract);

  int32_t game = 0;
  while (frame < START_FRAME + 600) {
    const int32_t p = runFrame();
    game = p > game ? p : game;
  }
  TEST_ASSERT_GREATER_THAN_INT32(20, game);
}

// main Z80 ROM in three planned chunks: 0000-7fff fixed, 8000-bfff one of
// 8 pages selected by c804 bits 4-2 (pages 0-3 in p03, 4-7 in p47)
static void test_rom_pages_follow_c804(void) {
  boot();
  const uint8_t *fixed = machine->_1943_rom_fixed.data();
  for (uint16_t k : {0, 0x1234, 0x7fff}) {
    TEST_ASSERT_EQUAL_HEX8(fixed[k], machine->rdZ80(k));
  }
  for (uint8_t bank = 0; bank < 8; bank++) {
    const uint8_t *page = (bank < 4 ? machine->_1943_rom_p03.data() : machine->_1943_rom_p47.data())
                          + (bank & 3) * 0x4000;
    machine->c804 = bank << 2;
    for (uint16_t k : {0, 0x2345, 0x3fff}) {
      TEST_ASSERT_EQUAL_HEX8(page[k], machine->rdZ80(0x8000 + k));
    }
  }
}
#endif

int main(int argc, char **argv) {
  UNITY_BEGIN();
#ifdef HAVE_ROM
  RUN_TEST(test_boot_starts_game);
  RUN_TEST(test_fm_music_after_coin);
  RUN_TEST(test_rom_pages_follow_c804);
#endif
  return UNITY_END();
}
