// one guard per System 1 game: system1_palette.h is generated by romconv
#include "../../catalog.h"
#if defined(GAME_STARJACK) || defined(GAME_REGULUS) || defined(GAME_UPNDOWN) || \
    defined(GAME_RAFLESIA) || defined(GAME_SWAT) || defined(GAME_FLICKY) || \
    defined(GAME_PITFALL2) || \
    defined(GAME_MRVIKING) || \
    defined(GAME_IMSORRY) || \
    defined(GAME_WBOY) || \
    defined(GAME_FOURDWARRIO) || \
    defined(GAME_HVYMETAL) || \
    defined(GAME_GARDIA)

#include "system1.h"
#include "system1_palette.h"

using namespace system1_video;

namespace {

// main CPU address map (MAME system1_map)
constexpr uint16_t ROM_END = 0xc000;
constexpr uint16_t OPCODES_END = 0x8000;     // Sega encryption covers 0000-7fff only
constexpr uint16_t BANK_BASE = 0x8000;       // 8000-bfff: banked ROM (Config::bank)
constexpr uint32_t BANK_SIZE = 0x4000;
constexpr uint16_t RAM_BASE = 0xc000;        // c000-efff: work, sprite, palette, video RAM
constexpr uint16_t PALETTE_BASE = 0xd800;
constexpr uint16_t COLLISION_BASE = 0xf000;
constexpr uint16_t MIX_RESET_BASE = 0xf400;
constexpr uint16_t SPR_COLLISION_BASE = 0xf800;
constexpr uint16_t SPR_RESET_BASE = 0xfc00;

// sound CPU address map (MAME sound_map)
constexpr uint16_t SOUND_ROM_END = 0x8000;
constexpr uint16_t SOUND_RAM_END = 0xa000;   // 8000-87ff, mirrored
constexpr uint16_t SOUND_RAM_MASK = 0x7ff;
constexpr uint16_t SN1_BASE = 0xa000;        // 2 MHz
constexpr uint16_t SN2_BASE = 0xc000;        // 4 MHz
constexpr uint16_t SOUND_LATCH_BASE = 0xe000;

// I/O ports (mask 0x1f)
constexpr uint8_t PORT_MASK = 0x1f;
constexpr uint8_t PORT_P2 = 0x04;
constexpr uint8_t PORT_SYSTEM = 0x08;
constexpr uint8_t PORT_DSW = 0x0c;           // 0c/0e SWA, 0d/0f SWB
constexpr uint8_t PORT_DSWB = 0x10;
constexpr uint8_t PORT_PPI = 0x14;          // 14-17, sys1ppi
constexpr uint8_t PORT_PIO = 0x18;          // 18-1b, sys1pio
constexpr uint8_t PORT_END = 0x1c;

// inputs, active low
constexpr uint8_t IN_BUTTON2 = 0x02;
constexpr uint8_t IN_BUTTON1 = 0x04;
constexpr uint8_t IN_DOWN = 0x10;
constexpr uint8_t IN_UP = 0x20;
constexpr uint8_t IN_RIGHT = 0x40;
constexpr uint8_t IN_LEFT = 0x80;
constexpr uint8_t IN_COIN1 = 0x01;
constexpr uint8_t IN_START1 = 0x10;

// START button: BUTTON_START with a COIN pin (EXTRA is then COIN) or the
// galagino controller, else START itself reports as BUTTON_EXTRA
#if defined(BTN_COIN_PIN) || defined(GALAGINO_CONTROLLER)
constexpr unsigned int START_KEY = BUTTON_START;
#else
constexpr unsigned int START_KEY = BUTTON_EXTRA;
#endif

} // namespace

system1::system1(const Roms &r, const Config &c)
    : tile_rom(r.tiles), tile_map(r.tileMap), main_rom(r.main_cpu), sprite_rom(r.sprites),
      sound_rom(r.sound_cpu), lookup_prom(r.lookup), opcode_rom(r.opcodes), bank_rom(r.banks),
      config(c) {
  // eager: blocks come from romconv (<game>_arena_plan.h), any order fits
  spriteRom = sprite_rom.data();
  tiles.gfx = tile_rom.data();
  mainRom = main_rom.data();
  soundRom = sound_rom.data();
  prom = lookup_prom.data();
  tiles.map = tile_map.data();
  opcodes = opcode_rom.data();
  banks = config.bank == BANK_NONE ? nullptr : bank_rom.data();
  bank = nullptr;
  paletteLut = r.palette ? r.palette : system1_palette;
  tiles.mask = tile_map.size() - 1;  // romconv asserts a power of two
  tiles.layout = config.orientation == ROT0 ? TILES_BY_ROW : TILES_BY_COLUMN;
  clearShowsBg = buildMixSel(prom, mixSel);

  mainRomSize = main_rom.size();
  soundRomSize = sound_rom.size();
  spriteBanks = sprite_rom.size() / SPRITE_BANK;
  firstStrip = rowOfX(config.vis.x1) / STRIP_LINES;
  lastStrip = rowOfX(config.vis.x0) / STRIP_LINES;
  if (config.orientation == ROT0) {
    firstStrip = ROT0_FIRST_ROW / STRIP_LINES;
    lastStrip = (ROT0_FIRST_ROW + VIS_LINES) / STRIP_LINES - 1;
  }
}

void system1::reset() {
  machineBase::reset();

  ppi.reset();
  pio.reset();
  mainIrq = false;
  soundIrq = false;
  selectBank();

  memset(palette, 0, sizeof(palette));
  collision.reset();
  activeCount = 0;
  winX = windowTarget(config.window, NO_PLAYER);
  follow = WindowFollow{};
}

unsigned char system1::opZ80(unsigned short Addr) {
  if (current_cpu == MAIN_CPU) {
    if (opcodes && Addr < OPCODES_END) {
      return opcodes[Addr];
    }
    return Addr < mainRomSize ? mainRom[Addr] : mainRead(Addr);
  }
  return Addr < soundRomSize ? soundRom[Addr] : soundRead(Addr);
}

unsigned char system1::rdZ80(unsigned short Addr) {
  return current_cpu == MAIN_CPU ? mainRead(Addr) : soundRead(Addr);
}

void system1::wrZ80(unsigned short Addr, unsigned char Value) {
  if (current_cpu == MAIN_CPU) {
    mainWrite(Addr, Value);
    return;
  }
  soundWrite(Addr, Value);
}

uint8_t system1::mainRead(uint16_t a) {
  if (a < ROM_END) {
    if (a < mainRomSize) {
      return mainRom[a];
    }
    return bank && a >= BANK_BASE ? bank[a - BANK_BASE] : 0xff;
  }
  if (a < COLLISION_BASE) {
    return memory[a - RAM_BASE];
  }
  if (a < MIX_RESET_BASE) {
    return collision.mixRead(a);
  }
  if (a >= SPR_COLLISION_BASE && a < SPR_RESET_BASE) {
    return collision.sprRead(a);
  }
  return 0xff;
}

void system1::mainWrite(uint16_t a, uint8_t v) {
  if (a < ROM_END) {
    return;
  }

  if (a < COLLISION_BASE) {
    memory[a - RAM_BASE] = v;
    if (a >= PALETTE_BASE && a - PALETTE_BASE < PALETTE_USED) {
      palette[a - PALETTE_BASE] = paletteLut[v];
    }
    return;
  }

  if (a < MIX_RESET_BASE) {
    collision.mixClear(a);
  } else if (a < SPR_COLLISION_BASE) {
    collision.mixReset();
  } else if (a < SPR_RESET_BASE) {
    collision.sprClear(a);
  } else {
    collision.sprReset();
  }
}

uint8_t system1::soundRead(uint16_t a) {
  if (a < SOUND_ROM_END) {
    return a < soundRomSize ? soundRom[a] : 0xff;
  }
  if (a < SOUND_RAM_END) {
    return memory[SOUND_RAM + (a & SOUND_RAM_MASK)];
  }
  if (a >= SOUND_LATCH_BASE) {
    return ackSoundLatch();
  }
  return 0xff;
}

void system1::soundWrite(uint16_t a, uint8_t v) {
  if (a < SOUND_ROM_END) {
    return;
  }

  if (a < SOUND_RAM_END) {
    memory[SOUND_RAM + (a & SOUND_RAM_MASK)] = v;
  } else if (a >= SN1_BASE && a < SN2_BASE) {
    sn[0].write(v);
  } else if (a < SOUND_LATCH_BASE) {
    sn[1].write(v);
  }
}

unsigned char system1::inZ80(unsigned short Port) {
  if (current_cpu != MAIN_CPU) {
    return 0xff;
  }

  const uint8_t p = Port & PORT_MASK;
  if (p < PORT_P2) {
    return readP1();
  }
  if (p < PORT_SYSTEM) {
    return 0xff;  // P2, cocktail only
  }
  if (p < PORT_DSW) {
    game_started = 1;
    return readSystem();
  }
  if (p < PORT_DSWB) {
    return (p & 1) ? dswB() : dswA();
  }
  if (p < PORT_PPI) {
    return dswB();
  }
  if (config.board == BOARD_PIO) {
    return p >= PORT_PIO && p < PORT_END ? pio.read(p - PORT_PIO) : 0xff;
  }
  return p < PORT_PIO ? ppi.read(p - PORT_PPI) : 0xff;
}

void system1::outZ80(unsigned short Port, unsigned char Value) {
  const uint8_t p = Port & PORT_MASK;
  if (current_cpu != MAIN_CPU || p < PORT_PPI || p >= PORT_END) {
    return;
  }

  if (config.board == BOARD_PIO) {
    if (p >= PORT_PIO) {
      pio.write(p - PORT_PIO, Value);
    }
  } else if (p < PORT_PIO) {
    ppi.write(p - PORT_PPI, Value);
  }
  selectBank();
}

// MAME bank44_custom_w: video mode bits 6 and 2 pick one of 4 banks
void system1::selectBank() {
  if (!banks) {
    return;
  }
  const uint8_t m = videoMode();
  const uint32_t entry = ((m & 0x40) >> 5) | ((m & 0x04) >> 2);
  bank = banks + (entry % (bank_rom.size() / BANK_SIZE)) * BANK_SIZE;
}

// sound latch and video mode live on the PPI or the PIO, by board
bool system1::takeSoundNmi() {
  return config.board == BOARD_PIO ? pio.takeNmi() : ppi.takeNmi();
}

uint8_t system1::ackSoundLatch() {
  return config.board == BOARD_PIO ? pio.ackA() : ppi.ackA();
}

uint8_t system1::videoMode() const {
  return config.board == BOARD_PIO ? pio.portB() : ppi.portB();
}

// FIRE drives BUTTON1; galagino controller B, or START in two weapon games
// (Regulus bomb), drives BUTTON2
uint8_t system1::readP1() {
  const unsigned int k = input->buttons_get();
  const bool swapped = config.buttons == BUTTONS_SWAPPED;
  uint8_t v = 0xff;
  if (k & BUTTON_FIRE) {
    v &= swapped ? ~IN_BUTTON2 : ~IN_BUTTON1;
  }
  if ((k & BUTTON_B) || (config.startButton2 && (k & START_KEY))) {
    v &= swapped ? ~IN_BUTTON1 : ~IN_BUTTON2;
  }
  if (k & BUTTON_DOWN) {
    v &= ~IN_DOWN;
  }
  if (k & BUTTON_UP) {
    v &= ~IN_UP;
  }
  if (k & BUTTON_RIGHT) {
    v &= ~IN_RIGHT;
  }
  if (k & BUTTON_LEFT) {
    v &= ~IN_LEFT;
  }
  return v;
}

uint8_t system1::readSystem() {
  const unsigned int k = input->buttons_get();
  uint8_t v = 0xff;
  if (k & BUTTON_COIN) {
    v &= ~IN_COIN1;
  }
  if (k & BUTTON_START) {
    v &= ~IN_START1;
  }
  return v;
}

void system1::run_frame(void) {
  for (int line = 0; line < FRAME_LINES; line++) {
    if (line % SOUND_IRQ_PERIOD == SOUND_IRQ_FIRST) {
      soundIrq = true;
    }
    irqLines();

    // sound CPU first: at power-on it must set SP before the main CPU's
    // PPI init raises the first sound NMI (Regulus crashed its sound CPU)
    current_cpu = SOUND_CPU;
    if (takeSoundNmi()) {
      IntZ80(&cpu[SOUND_CPU], INT_NMI);
    }
    for (int i = 0; i < SOUND_STEPS_PER_LINE; i++) {
      StepZ80(&cpu[SOUND_CPU]);
    }

    current_cpu = MAIN_CPU;
    for (int i = 0; i < MAIN_STEPS_PER_LINE; i++) {
      StepZ80(&cpu[MAIN_CPU]);
    }

    if (line == VBLANK_LINE) {
      startVblank();
    }
  }
}

// Collision of the frame just shown, latch the video state, main IRQ.
void system1::startVblank() {
  const uint8_t *vram = &memory[VIDEO_RAM];

  const Collision::Frame f = {&memory[SPRITE_RAM], spriteRom, spriteBanks, vram,
                              tiles, prom, videoMode(), config.vis};
  collision.scan(f);

  vblank.publish([this, vram](VideoState &v) {
    memcpy(v.sprite_ram, &memory[SPRITE_RAM], sizeof(v.sprite_ram));
    memcpy(v.bg_page, vram, sizeof(v.bg_page));
    v.scroll_x_lo = vram[SCROLL_X_LO];
    v.scroll_x_hi = vram[SCROLL_X_HI];
    v.scroll_y = vram[SCROLL_Y];
    v.mode = videoMode();
  });

  mainIrq = true;
}

// IRQs are HOLD_LINE in MAME: kept until the CPU accepts them, so one that
// lands in a DI section (e.g. the sound NMI handler) is delayed, not lost.
void system1::irqLines() {
  if (mainIrq && (cpu[MAIN_CPU].IFF & IFF_1)) {
    mainIrq = false;
    current_cpu = MAIN_CPU;
    IntZ80(&cpu[MAIN_CPU], INT_IRQ);
  }
  if (soundIrq && (cpu[SOUND_CPU].IFF & IFF_1)) {
    soundIrq = false;
    current_cpu = SOUND_CPU;
    IntZ80(&cpu[SOUND_CPU], INT_IRQ);
  }
}

// Visible sprites with their widest row, so strips can skip them cheaply.
void system1::prepare_frame(void) {
  vblank.read(video);
  activeCount = 0;
  if (video.mode & VIDEO_BLANK) {
    return;
  }

  Sprite list[SPRITES];
  const int count = decodeSprites(video.sprite_ram, spriteBanks, list);
  for (int n = 0; n < count; n++) {
    const Sprite &s = list[n];
    if (s.bottom <= 0 || s.top >= VIS_LINES) {
      continue;
    }

    const uint8_t *bank = spriteRom + s.bank * SPRITE_BANK;
    const int y0 = s.top > 0 ? s.top : 0;
    const int y1 = s.bottom < VIS_LINES ? s.bottom : VIS_LINES;
    int width = 0;
    for (int y = y0; y < y1; y++) {
      const int w = walkRow(bank, rowAddr(s, y), [](int, uint8_t) {});
      width = w > width ? w : width;
    }

    const int x0 = spriteX(s.x);
    if (width == 0 || x0 > config.vis.x1 || x0 + width <= config.vis.x0) {
      continue;
    }

    ActiveSprite &a = active[activeCount++];
    a.s = s;
    a.number = n;
    a.x0 = x0;
    a.width = width;
  }

  if (config.orientation == ROT0) {
    winX = easeWindow(winX, follow.target(config.window, playerX()));
  }
}

// center x of the player sprite if it is on screen, else NO_PLAYER
int system1::playerX() const {
  for (int a = 0; a < activeCount; a++) {
    if (active[a].number == config.window.playerSprite) {
      return active[a].x0 + active[a].width / 2;
    }
  }
  return NO_PLAYER;
}

const int system1::renderWidth() {
  return config.orientation == ROT0 ? ROT0_WIDTH : VIS_LINES;
}

void system1::render_row(short strip) {
  if (strip < firstStrip || strip > lastStrip || (video.mode & VIDEO_BLANK)) {
    return;
  }
  if (config.orientation == ROT0) {
    renderRot0(strip);
    return;
  }
  drawSprites(strip);
  mixStrip(strip);
}

// ROT0: per native line the sprite pens, then tiles mixed over the window
void system1::renderRot0(int strip) {
  const LineSrc f = lineSrc();
  for (int l = 0; l < STRIP_LINES; l++) {
    const int y = strip * STRIP_LINES + l - ROT0_FIRST_ROW;
    const int fgX0 = y < config.window.hudLines ? config.window.hudX : winX;
    uint16_t *out = &frame_buffer[l * ROT0_WIDTH];
    uint32_t sprCols = 0;
    for (int a = 0; a < activeCount; a++) {
      const ActiveSprite &as = active[a];
      sprCols |= spriteRow(spriteRom + as.s.bank * SPRITE_BANK, as.s, as.x0,
                           as.number * PENS_PER_SPRITE, y, winX, ROT0_WIDTH, out);
    }
    renderRow(f, y, winX, fgX0, ROT0_WIDTH, sprCols, out);
  }
}

system1_video::LineSrc system1::lineSrc() const {
  const LineSrc f = {&memory[VIDEO_RAM + PAGE_BYTES],  // fixed layer, read live
                     video.bg_page,
                     tiles,
                     palette,
                     mixSel,
                     clearShowsBg,
                     bgScroll(video.scroll_x_lo, video.scroll_x_hi),
                     video.scroll_y};
  return f;
}

// Sprite pens (sprite * 16 + nibble, never 0) into frame_buffer, later wins.
__attribute__((flatten)) void system1::drawSprites(int strip) {
  const int firstRow = strip * STRIP_LINES;
  const int xHi = xOfRow(firstRow);
  const int xLo = xOfRow(firstRow + STRIP_LINES - 1);
  memset(sprTiles, 0, sizeof(sprTiles));

  for (int a = 0; a < activeCount; a++) {
    const ActiveSprite &as = active[a];
    if (as.x0 > xHi || as.x0 + as.width <= xLo) {
      continue;
    }

    const uint8_t *bank = spriteRom + as.s.bank * SPRITE_BANK;
    const uint16_t penBase = as.number * PENS_PER_SPRITE;
    const int y0 = as.s.top > 0 ? as.s.top : 0;
    const int y1 = as.s.bottom < VIS_LINES ? as.s.bottom : VIS_LINES;
    if (y0 >= y1) {
      continue;
    }

    // tile rows this sprite may touch: mixStrip skips sprite checks elsewhere
    const uint32_t rows = (2u << ((y1 - 1) / TILE_SIZE)) - (1u << (y0 / TILE_SIZE));
    for (int l = 0; l < STRIP_LINES; l++) {
      const int x = xHi - l;
      if (x >= as.x0 && x < as.x0 + as.width) {
        sprTiles[l] |= rows;
      }
    }

    for (int y = y0; y < y1; y++) {
      walkRow(bank, rowAddr(as.s, y), [&](int i, uint8_t c) {
        const int x = as.x0 + i;
        if (c == 0 || x < xLo || x > xHi) {
          return;
        }
        frame_buffer[(rowOfX(x) - firstRow) * VIS_LINES + y] = penBase | c;
      });
    }
  }
}

// fg + bg tiles and the sprite pens mixed line by line (renderLine)
void system1::mixStrip(int strip) {
  const LineSrc f = lineSrc();

  for (int l = 0; l < STRIP_LINES; l++) {
    renderLine(f, xOfRow(strip * STRIP_LINES + l), sprTiles[l], &frame_buffer[l * VIS_LINES]);
  }
}

#endif // System 1 games
